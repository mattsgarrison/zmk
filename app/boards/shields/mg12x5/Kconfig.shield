## app/boards/shields/mg12x5/Kconfig.shield
```kconfig
# Copyright (c) 2020 The ZMK Contributors
# SPDX-License-Identifier: MIT
# https://zmkfirmware.dev/docs/development/new-shield#kconfigshield

config mg12x5
    def_bool $(shields_list_contains,mg12x5)
```
